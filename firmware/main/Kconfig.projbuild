## firmware/main/Kconfig.projbuild
```kconfig
menu "AXION"

    config AXION_ATOM_ID
        string "ATOM identifier (atom-a|atom-b|atom-c)"
        default "atom-a"

    config AXION_ZONE
        string "Monitored zone (A|B|C)"
        default "A"

    config AXION_WIFI_SSID
        string "2.4 GHz Wi-Fi SSID"
        default ""
        help
            Empty = Wi-Fi disabled (firmware runs scan + filter only, useful
            for the BLE/filter phases). The ESP32 only supports 2.4 GHz.

    config AXION_WIFI_PASSWORD
        string "Wi-Fi password"
        default ""

    config AXION_API_URL
        string "API base URL (no trailing slash)"
        default "http://192.168.0.10:8000"
        help
            The firmware POSTs to <URL>/api/readings and fetches the whitelist
            from <URL>/api/beacons/active.

endmenu
```

## firmware/sdkconfig.defaults
```kconfig
CONFIG_IDF_TARGET="esp32"

# Bluetooth - NimBLE, observer (scan) + central.
# Central must stay enabled: on the ESP32 the NimBLE port forces
# MYNEWT_VAL_BLE_HOST_BASED_PRIVACY=1 (esp_nimble_cfg.h), which references
# ble_sm_alg_encrypt, and ble_sm_alg.c only compiles with NIMBLE_BLE_CONNECT
# (central||peripheral). Observer-only does not link (seen on IDF v6).
CONFIG_BT_ENABLED=y
CONFIG_BT_NIMBLE_ENABLED=y
CONFIG_BTDM_CTRL_MODE_BLE_ONLY=y
CONFIG_BT_NIMBLE_ROLE_OBSERVER=y
CONFIG_BT_NIMBLE_ROLE_CENTRAL=y
CONFIG_BT_NIMBLE_ROLE_PERIPHERAL=n
CONFIG_BT_NIMBLE_ROLE_BROADCASTER=n
CONFIG_BT_NIMBLE_HOST_TASK_STACK_SIZE=5120

# Wi-Fi/BLE software coexistence
CONFIG_ESP_COEX_SW_COEXIST_ENABLE=y

# Flash / partitions
CONFIG_ESPTOOLPY_FLASHSIZE_4MB=y
CONFIG_PARTITION_TABLE_CUSTOM=y
CONFIG_PARTITION_TABLE_CUSTOM_FILENAME="partitions.csv"

# System
CONFIG_ESP_TASK_WDT_TIMEOUT_S=10
CONFIG_FREERTOS_HZ=1000

# ===== FILL IN with YOUR network - shared by all 3 ATOMs =====
# (so the atom-a/b/c presets carry Wi-Fi + identity together, and deleting
#  sdkconfig no longer loses the network). Must be a 2.4 GHz network.
# Replace the IP with the IP of the PC running the server (ipconfig).
CONFIG_AXION_WIFI_SSID="YOUR_WIFI_2G"
CONFIG_AXION_WIFI_PASSWORD="YOUR_PASSWORD"
CONFIG_AXION_API_URL="http://192.168.0.42:8000"
```
